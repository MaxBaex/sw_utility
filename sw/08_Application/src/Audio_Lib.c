/**
  * ############################################################################
  * @file     Audio_Lib.c
  * @brief    New Vario
  * @author   Horst Rupp
  * @brief    This task
  * ############################################################################
  */
//
// Includes
//
#include  "Generic_Common.h"
#include  "Generic_Includes.h"

#include  "task_Audio_Controller.h"

extern  DAC_HandleTypeDef hdac1;
extern  DMA_HandleTypeDef hdma_dac1;
extern  TIM_HandleTypeDef htim6;

#define c_Wave_Size  128

//
//  sinus + 16te harmonic  (HMR 27.4.21)
//
#if 1		// Sinus mit 16. harmonischer Oberwelle 30%
float Wave_Raw[c_Wave_Size] = {
		0.000000,
		258.162537,
		488.604238,
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		-488.604238,
		-258.162537
  };
#endif
// *********************
#if 0			// reiner Sinuston
float Wave_Raw[c_Wave_Size] = {
	0.000000,
	100.490597,
	200.739103,
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	-200.739103,
	-100.490597
  };
#endif
// *********************



uint32_t  Wave[c_Wave_Size] = { 0 };
uint8_t   m_up, m_half;
uint16_t  m_Prev_Frequency, m_Prev1_Volume, m_Prev2_Volume;
//extern uint16_t  g_Next_Frequency, g_Next_Volume;

#define c_change_first_half    0
#define c_change_second_half   1

//
// *****************************************************************************
//
void Set_Volume ( uint16_t vol )
{
  uint8_t l_ix, l_first_ix, l_last_ix;
  int16_t  iyy;
  float     ixx;

  if ( vol > 1000 )     // representing 100.0% Volume
    vol = 1000;

  //
  //  Organize according to IRs at
  //  HAL_DAC_Conv_HALF_CpltCallbackCh1
  //  and
  //  HAL_DAC_Conv_**_CpltCallbackCh1
  //  to change volume on the fly
  //
  if ( m_half == 0 )
  {
    l_first_ix  = 0;
    l_last_ix   = c_Wave_Size/2;
  }
  else
  {
    l_first_ix  = c_Wave_Size/2;
    l_last_ix   = c_Wave_Size;
  }

  //
  //  Move the appropriate half of data into hot area
  //
  for ( l_ix = l_first_ix; l_ix < l_last_ix; l_ix++ )
  {
    ixx = Wave_Raw[l_ix] * 0.001 * (float) ( vol * 10 );
    iyy = round ( ixx );
    Wave[l_ix] = 2048 + iyy;
  }
}

//
// *****************************************************************************
//
void Set_Frequency ( uint16_t freq )
{
  uint16_t l_retcode;
  uint16_t  l_period = 168000000 / freq / c_Wave_Size;
  htim6.Init.Period = l_period;
  l_retcode = HAL_TIM_Base_Init(&htim6);
  ASSERT (l_retcode == HAL_OK);
}

// =============================================================================
//

void Start_Audio (uint16_t vol, uint16_t freq )
{
  HAL_StatusTypeDef   l_HAL_retcode;
  m_half  = 0;
  Set_Volume ( vol );     // Start-Lautstaerke
  m_half  = 1;
  Set_Volume ( vol );
  m_half  = 1;            // Start-Frequenz
  Set_Frequency ( freq );
  l_HAL_retcode = HAL_DAC_Start_DMA   ( &hdac1,
                                        DAC_CHANNEL_1,
                                        (uint32_t*)Wave,
                                        c_Wave_Size,
                                        DAC_ALIGN_12B_R
                                      );
  ASSERT ( l_HAL_retcode == HAL_OK );
  HAL_TIM_Base_Start  ( &htim6 );
  ASSERT ( l_HAL_retcode == HAL_OK );
}

//
// *****************************************************************************
//
void HAL_DAC_ConvHalfCpltCallbackCh1(DAC_HandleTypeDef *hdac1)
{
  m_half = 0;
  if  ( m_Prev1_Volume != g_Next_Volume )
  {
    m_Prev1_Volume = g_Next_Volume;
    Set_Volume ( g_Next_Volume );
  }

  if  ( m_Prev_Frequency != g_Next_Frequency )
  {
    m_Prev_Frequency = g_Next_Frequency;
    Set_Frequency ( g_Next_Frequency );
  }
}

//
// *****************************************************************************
//
void HAL_DAC_ConvCpltCallbackCh1(DAC_HandleTypeDef *hdac)
{
  m_half = 1;
  if  ( m_Prev2_Volume != g_Next_Volume )
  {
    m_Prev2_Volume = g_Next_Volume;
    Set_Volume ( g_Next_Volume );
  }
  if  ( m_Prev_Frequency != g_Next_Frequency )
  {
    m_Prev_Frequency = g_Next_Frequency;
    Set_Frequency ( g_Next_Frequency );
  }
}

//
// *******************************************************************************
// The End
// *******************************************************************************
